#include <physical_layouts.dtsi>

{
    physical_layout0: physical_layout_0 {
        compatible = "zmk,physical-layout";
        display-name = "3x3Pad";

        kscan = <&kscan1>;
        transform = <&default_transform>;

        keys  //                     w   h    x    y     rot    rx    ry
            = <&key_physical_attrs 100 100    0    0       0     0     0>
            , <&key_physical_attrs 100 100    0  100       0     0     0>
            , <&key_physical_attrs 100 100  100  100       0     0     0>
            ;
    };
};
